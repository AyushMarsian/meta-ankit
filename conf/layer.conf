## conf/layer.conf
```bitbake
# We have a conf and classes directory, add to BBPATH
BBPATH .= ":${LAYERDIR}"

# We have recipes-* directories, add to BBFILES
BBFILES += "${LAYERDIR}/recipes-*/*/*.bb \
            ${LAYERDIR}/recipes-*/*/*.bbappend"

BBFILE_COLLECTIONS += "meta-ankit"
BBFILE_PATTERN_meta-ankit = "^${LAYERDIR}/"
BBFILE_PRIORITY_meta-ankit = "6"

LAYERDEPENDS_meta-ankit = "core"
LAYERSERIES_COMPAT_meta-ankit = "kirkstone"
```
